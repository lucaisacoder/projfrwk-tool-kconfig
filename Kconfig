## Kconfig
```kconfig
mainmenu "Project Framework Kconfig Configuration"

menu "Toolchain configuration"
	config TOOLCHAIN_PATH
		string "toolchain path"
		default ""
	
	config TOOLCHAIN_PREFIX
		string "toolchain prefix"
		default ""
endmenu

menu "Components configuration"
	osource "${SDK_PATH}/components/*/Kconfig"
	osource "${SDK_PATH}/components/*/Kconfig"
endmenu
```
